## prj.conf
```kconfig
CONFIG_ZTEST=y

# Enable m6e nano device driver
CONFIG_UART_INTERRUPT_DRIVEN=y
CONFIG_SERIAL=y
CONFIG_M6E_NANO=y

# Logging
CONFIG_LOG=y
```

## src/main.c
```c
#include <zephyr/ztest.h>
// #include <drivers/m6e-nano/m6e_nano.h>

/**
 * @brief Test Asserts
 *
 * This test verifies various assert macros provided by ztest.
 *
 */
static void test_assert(void)
{
	zassert_true(1, "1 was false");
	zassert_false(0, "0 was true");
	zassert_is_null(NULL, "NULL was not NULL");
	zassert_not_null("foo", "\"foo\" was NULL");
	zassert_equal(1, 1, "1 was not equal to 1");
	zassert_equal_ptr(NULL, NULL, "NULL was not equal to NULL");
}

void test_main(void)
{
	ztest_test_suite(framework_tests, ztest_unit_test(test_assert));

	ztest_run_test_suite(framework_tests);
}
```
