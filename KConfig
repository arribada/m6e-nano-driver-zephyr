## boards/xtensa/esp32_feather/Kconfig.board
```kconfig
# Copyright (c) 2023 Espressif Systems (Shanghai) Co., Ltd.
# SPDX-License-Identifier: Apache-2.0

config BOARD_ESP32_FEATHER
	bool "ESP32-FEATHER Development Board"
	depends on SOC_SERIES_ESP32

choice SOC_PART_NUMBER
	default SOC_ESP32_WROOM_32UE_N4
endchoice
```

## drivers/m6e-nano/Kconfig
```kconfig
menu "M6E Nano UART Peripheral"
config M6E_NANO
    bool "Enable m6e nano peripheral"
    depends on UART_INTERRUPT_DRIVEN

if M6E_NANO

    config M6E_NANO_DEFAULT_REGION
        hex "Default region in (hex), see README for details"
        default 0x08
        range 0x04 0xFF
        help
            Sets the interal frequency determined by region for M6E Nano.

    config M6E_NANO_DEFAULT_POWER
        int "Default maximum transmission power level of 500 (5.00dBm)"
        default 500
        range 0 2700
        help
            Maximum transmission power of device, in dBm. Maximum value is 2700 (27.00dBm).
    
    module = M6E_NANO
    module-str = M6E Nano
    source "subsys/logging/Kconfig.template.log_config"
endif
endmenu
```

## drivers/m6e_nano/KConfig
```kconfig
menu "M6E Nano UHF RFID Driver"
config M6E_NANO
    bool "Enable M6E Nano Driver"
    depends on UART_INTERRUPT_DRIVEN && GPIO

if M6E_NANO

    config M6E_NANO_RX_BUF_SIZE
        int "rx buffer size (bytes)"
        default 64
        range 0 2047
        help
            Size of uart rx buffer. Will be allocated for each device.

    config M6E_NANO_MAX_STR_LEN
        int "Maximum string length"
        default 64
        range 0 2047
        help
            Maximum length of string that can be transmitted by device. A buffer capable of containing that string will be allocated for each device.
    
    module = M6E_NANO
    module-str = M6E Nano
    source "subsys/logging/Kconfig.template.log_config"
endif
endmenu
```

## drivers/sensor/m6e_nano/Kconfig
```kconfig
# PMS7003 particulate matter sensor configuration options

# Copyright (c) 2017 Intel Corporation
# SPDX-License-Identifier: Apache-2.0

config M6ENANO
	bool "M6E Nano RFID reader"
	default y
	select SERIAL
	help
	  Enable driver for M6E Nano UHF RFID Reader.
```

## dts/bindings/sensor/thingmagic,m6enano.yaml
```yaml
description: |
  M6E Nano Serial RFID reader. UHF RFID tag reader over serial.

compatible: "thingmagic,m6enano"

include: [base.yaml, uart-device.yaml]
```

## tests/integration/testcase.yaml
```yaml
tests:
  sample.pytest.shell:
    filter: CONFIG_SERIAL and dt_chosen_enabled("zephyr,shell-uart")
    min_ram: 40
    harness: pytest
    harness_config:
      pytest_args: ['--html=twister-out/pytest-report.html', '--self-contained-html']
    extra_configs:
      - arch:posix:CONFIG_NATIVE_UART_0_ON_STDINOUT=y
    platform_allow:
      - native_sim
      - swan_r5
    integration_platforms:
      - native_sim
      - swan_r5
    tags:
      - test_framework
      - pytest
      - shell
```

## tests/testcase.yaml
```yaml
tests:
  drivers.sensor.m6e_nano.framework_tests:
    tags:
      - drivers
      - sensor
      - subsys
    platform_allow: rpi_pico
```

## tests/unit/testcase.yaml
```yaml
tests:
  codec_tests.test_encoding_of_sensor_data:
    platform_allow:
      - swan_r5
    tags: driver
```

## west.yml
```yaml
manifest:
  defaults:
    revision: main

  remotes:
    - name: zephyr
      url-base: https://github.com/zephyrproject-rtos/
    - name: arribada
      url-base: https://github.com/arribada/

  projects:
    - name: zephyr
      remote: zephyr
      path: zephyr
      revision: v3.5.0
      import:
        name-allowlist:
          - cmsis # required by the ARM port
          - hal_rpi_pico
          - hal_stm32 
          - hal_espressif
    - name: arribada-custom-boards
      path: deps/custom-boards
      revision: v3.5.0
      url: https://github.com/arribada/custom-boards-zephyr

  self:
    path: m6e-nano-driver-zephyr
```
